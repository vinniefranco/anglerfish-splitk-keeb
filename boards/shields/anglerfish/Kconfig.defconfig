## boards/shields/anglerfish/Kconfig.defconfig
```kconfig
if SHIELD_ANGLERFISH_RIGHT

config ZMK_KEYBOARD_NAME
  default "AF-TB"

config ZMK_SPLIT_ROLE_CENTRAL
  default y

endif

if SHIELD_ANGLERFISH_LEFT || SHIELD_ANGLERFISH_RIGHT

config ZMK_SPLIT
  default y

endif

config MOUSE_LAYER_INDEX
  int "Index of mouse layer"
  defaut 5

config MOUSE_LAYER_ACTIVE_MS
  int "Amount of milliseconds the mouse layer will be active after using the trackball"
  default 400
```

## boards/shields/anglerfish/Kconfig.shield
```kconfig
config SHIELD_ANGLERFISH
  def_bool $(shields_list_contains,anglerfish)

config SHIELD_ANGLERFISH_LEFT
  def_bool $(shields_list_contains,anglerfish_left)

config SHIELD_ANGLERFISH_RIGHT
  def_bool $(shields_list_contains,anglerfish_right)
```
